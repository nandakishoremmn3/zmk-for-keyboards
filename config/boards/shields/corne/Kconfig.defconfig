## config/boards/shields/corne/Kconfig.defconfig
```kconfig
if SHIELD_CORNE_LEFT

config ZMK_KEYBOARD_NAME
	default "Corne"

config ZMK_SPLIT_ROLE_CENTRAL
	default y

endif

if SHIELD_CORNE_LEFT || SHIELD_CORNE_RIGHT

config ZMK_SPLIT
	default y

if ZMK_DISPLAY

config I2C
	default y

config SSD1306
	default y

endif # ZMK_DISPLAY

if LVGL

config LV_Z_VDB_SIZE
	default 64

config LV_DPI_DEF
	default 148

config LV_Z_BITS_PER_PIXEL
	default 1

choice LV_COLOR_DEPTH
	default LV_COLOR_DEPTH_1
endchoice

endif # LVGL

endif

if SHIELD_CORNE_RIGHT

config CORNE_CUSTOM_DISPLAY
	bool "Custom Corne display with logo and glitch effect"
	default y if ZMK_DISPLAY && !SHIELD_NICE_VIEW
	depends on ZMK_DISPLAY

if CORNE_CUSTOM_DISPLAY

choice ZMK_DISPLAY_STATUS_SCREEN
	default ZMK_DISPLAY_STATUS_SCREEN_CUSTOM
endchoice

config LV_USE_CANVAS
	default y

endif # CORNE_CUSTOM_DISPLAY

endif # SHIELD_CORNE_RIGHT
```
